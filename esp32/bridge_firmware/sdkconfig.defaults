## esp32/bridge_firmware/sdkconfig.defaults
```kconfig
# Classic SPP bridge: no Wi-Fi or audio runtime.
CONFIG_IDF_TARGET="esp32"
CONFIG_ESPTOOLPY_FLASHSIZE_16MB=y
CONFIG_ESPTOOLPY_FLASHMODE_DIO=y
CONFIG_ESPTOOLPY_FLASHFREQ_40M=y
CONFIG_ESP_DEFAULT_CPU_FREQ_MHZ_240=y
CONFIG_SPIRAM=y
CONFIG_SPIRAM_TYPE_ESPPSRAM64=y
CONFIG_SPIRAM_MODE_QUAD=y
CONFIG_SPIRAM_USE_MALLOC=y
CONFIG_SPIRAM_SPEED_40M=y
CONFIG_SPIRAM_BANKSWITCH_ENABLE=y
CONFIG_BT_ENABLED=y
CONFIG_BT_BLUEDROID_ENABLED=y
CONFIG_BT_ALLOCATION_FROM_SPIRAM_FIRST=y
CONFIG_BT_CONTROLLER_ENABLED=y
CONFIG_BT_CLASSIC_ENABLED=y
CONFIG_BT_SPP_ENABLED=y
CONFIG_BTDM_CTRL_MODE_BR_EDR_ONLY=y
CONFIG_BT_SMP_ENABLE=y
CONFIG_PARTITION_TABLE_CUSTOM=y
CONFIG_PARTITION_TABLE_CUSTOM_FILENAME="partitions.csv"
CONFIG_PARTITION_TABLE_OFFSET=0x8000
```

## esp32/firmware/main/Kconfig.projbuild
```kconfig
menu "Tivoo Wi-Fi"

config TIVOO_WIFI_SSID
    string "Wi-Fi SSID"
    default ""
    help
        Local 2.4 GHz Wi-Fi network name. Stored in the local sdkconfig.

config TIVOO_WIFI_PASSWORD
    string "Wi-Fi password"
    default ""
    help
        Local Wi-Fi password. Stored in the local sdkconfig and never logged.

config TIVOO_P68_TEST_GATE
    bool "P6.8 b5 software-only silent command gate"
    default n
    help
        Enables an uncalibrated logical sample boundary solely for b5 test
        builds before any TTS output. Do not enable on deployed hardware.
        This remains a software-only bypass, never a physical gate.

endmenu

menu "Tivoo I2S audio"

config TIVOO_I2S_BCLK_GPIO
    int "Shared BCLK GPIO"
    range 0 33
    default 4

config TIVOO_I2S_WS_GPIO
    int "Shared WS GPIO"
    range 0 33
    default 5

config TIVOO_I2S_DIN_GPIO
    int "INMP441 SD GPIO"
    range 0 39
    default 6

config TIVOO_I2S_DOUT_GPIO
    int "PCM5102 DIN GPIO"
    range -1 33
    default 7
    help
        -1 leaves DAC data disconnected and playback unavailable.

config TIVOO_AEC_REFERENCE_DELAY_SAMPLES
    int "Fixed TX to microphone reference delay in 16 kHz samples"
    range 0 800
    default 0
    help
        Uncalibrated S3 initial value only; measure the physical TX/RX
        alignment and acoustic path before enabling AFE.

config TIVOO_P68_PROMPT_CALIBRATED
    bool "Measured S3 prompt TX/RX/AFE gate calibration available"
    default n
    help
        Do not enable until b3/b6 physical measurements on the assembled
        S3, DAC, Tivoo and both microphones establish the two values below.
        Uncalibrated production turns fail closed rather than guessing.

config TIVOO_P68_PROMPT_TAIL_SAMPLES
    int "Measured acoustic safety tail after digital drain (16 kHz samples)"
    depends on TIVOO_P68_PROMPT_CALIBRATED
    range 0 80000
    default 0

config TIVOO_P68_PROMPT_AFE_OFFSET_SAMPLES
    int "Measured physical TX-clock to enhanced AFE sample offset"
    depends on TIVOO_P68_PROMPT_CALIBRATED
    range -80000 80000
    default 0

config TIVOO_AUDIO_PROBE
    bool "Log one-second audio measurements to UART"
    default n
    help
        Report raw left/right slot, filtered microphone, and AFE output
        levels without requiring a network connection or speech detection.

endmenu
```
